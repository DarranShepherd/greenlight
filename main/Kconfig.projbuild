## main/Kconfig.projbuild
```kconfig
menu "Greenlight"

choice GREENLIGHT_BOARD_PROFILE
    prompt "Board profile"
    default GREENLIGHT_BOARD_PROFILE_ESP32_2432S028_ILI9341
    help
        Select the currently targeted board profile. This remains a single build-time
        selection and defaults to the existing 2.8-inch CYD behavior.

config GREENLIGHT_BOARD_PROFILE_ESP32_2432S028_ILI9341
    bool "ESP32-2432S028 / ILI9341"

config GREENLIGHT_BOARD_PROFILE_ESP32_2432S028_ST7789
    bool "ESP32-2432S028 / ST7789"

config GREENLIGHT_BOARD_PROFILE_ESP32_32E_ST7789
    bool "ESP32-32E / ST7789"

config GREENLIGHT_BOARD_PROFILE_JC4827W543
    bool "JC4827W543 / NV3041A / GT911"

endchoice

config GREENLIGHT_GITHUB_OWNER
    string "GitHub OTA owner"
    default "DarranShepherd"
    help
        GitHub owner or organization for OTA release metadata and firmware assets.

config GREENLIGHT_GITHUB_REPO
    string "GitHub OTA repository"
    default "greenlight"
    help
        GitHub repository name that publishes OTA firmware releases.

config GREENLIGHT_DOCS_SCREENSHOT_MODE
    bool "Enable documentation screenshot firmware mode"
    default n
    help
        Build a deterministic firmware path that skips Wi-Fi, time sync, and tariff
        refresh, renders curated UI states, and streams LVGL snapshots over UART so
        host tooling can regenerate documentation screenshots on demand.

endmenu
```

## sdkconfig.defaults
```kconfig
# CONFIG_LV_FONT_MONTSERRAT_28 is not set
CONFIG_IDF_TARGET="esp32"
CONFIG_ESP_MAIN_TASK_STACK_SIZE=8192
CONFIG_ESP_DEFAULT_CPU_FREQ_MHZ_240=y
CONFIG_ESPTOOLPY_FLASHSIZE_4MB=y
CONFIG_PARTITION_TABLE_TWO_OTA_LARGE=y
CONFIG_LV_COLOR_DEPTH_16=y
CONFIG_LV_MEM_SIZE_KILOBYTES=56
CONFIG_LV_USE_OBSERVER=y
CONFIG_COMPILER_OPTIMIZATION_SIZE=y
CONFIG_COMPILER_OPTIMIZATION_ASSERTIONS_DISABLE=y
CONFIG_MBEDTLS_CERTIFICATE_BUNDLE_DEFAULT_NONE=y
CONFIG_MBEDTLS_CUSTOM_CERTIFICATE_BUNDLE=y
CONFIG_MBEDTLS_CUSTOM_CERTIFICATE_BUNDLE_PATH="certs/octopus-amazon-root-ca-1.pem"
CONFIG_MBEDTLS_CERTIFICATE_BUNDLE_MAX_CERTS=1
CONFIG_MBEDTLS_DYNAMIC_BUFFER=y
CONFIG_ESP_HTTPS_OTA_ENABLE_PARTIAL_DOWNLOAD=y
CONFIG_ESP_WIFI_SOFTAP_SUPPORT=n
CONFIG_ESP_WIFI_ENABLE_WPA3_SAE=n
CONFIG_ESP_WIFI_ENABLE_SAE_H2E=n
CONFIG_ESP_WIFI_ENABLE_SAE_PK=n
CONFIG_ESP_WIFI_SOFTAP_SAE_SUPPORT=n
CONFIG_ESP_WIFI_ENABLE_WPA3_OWE_STA=n
CONFIG_ESP_WIFI_WPA3_COMPATIBLE_SUPPORT=n
CONFIG_ESP_WIFI_ENTERPRISE_SUPPORT=n
CONFIG_LWIP_IPV6=n
# CONFIG_XPT2046_CONVERT_ADC_TO_COORDS is not set
CONFIG_LV_USE_THEME_DEFAULT=n
CONFIG_LV_USE_PERF_MONITOR=n
CONFIG_LV_BUILD_EXAMPLES=n
CONFIG_LV_BUILD_DEMOS=n
CONFIG_LV_USE_ANIMIMG=n
CONFIG_LV_USE_ARC=n
CONFIG_LV_USE_ARCLABEL=n
CONFIG_LV_USE_CALENDAR=n
CONFIG_LV_USE_CANVAS=n
CONFIG_LV_USE_CHART=n
CONFIG_LV_USE_CHECKBOX=n
CONFIG_LV_USE_IMAGEBUTTON=n
CONFIG_LV_USE_LED=n
CONFIG_LV_USE_LINE=n
CONFIG_LV_USE_LIST=n
CONFIG_LV_USE_MENU=n
CONFIG_LV_USE_MSGBOX=n
CONFIG_LV_USE_ROLLER=n
CONFIG_LV_USE_SCALE=n
CONFIG_LV_USE_SLIDER=n
CONFIG_LV_USE_SPAN=n
CONFIG_LV_USE_SPINBOX=n
CONFIG_LV_USE_SPINNER=n
CONFIG_LV_USE_SWITCH=n
CONFIG_LV_USE_TABLE=n
CONFIG_LV_USE_TABVIEW=n
CONFIG_LV_USE_WIN=n
CONFIG_MBEDTLS_SSL_IN_CONTENT_LEN=16384
```
